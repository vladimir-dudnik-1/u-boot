## board/bouffalo/bl808/Kconfig
```kconfig
if TARGET_BOUFFALO_BL808

config SYS_BOARD
	default "bl808"

config SYS_CONFIG_NAME
	default "bl808"

config SYS_CPU
	default "generic"

config SYS_VENDOR
	default "bouffalo"

config TEXT_BASE
	default 0x58000000 if XIP
	default 0x22020000 if BL808_CPU_M0
	default 0x50100000 if BL808_CPU_D0

config BOARD_SPECIFIC_OPTIONS # dummy
	def_bool y
	select BOARD_EARLY_INIT_F
	select DM_GPIO if GPIO
	select GENERIC_RISCV
	select OF_HAS_PRIOR_STAGE if RISCV_SMODE
	imply BFLB_SERIAL
	imply RISCV_TIMER

choice
	prompt "CPU selection"

config BL808_CPU_M0
	bool "Run from SRAM on M0"

config BL808_CPU_D0
	bool "Run from PSRAM on D0"

endchoice

endif
```

## configs/bl808_d0_defconfig
```kconfig
CONFIG_RISCV=y
CONFIG_NR_DRAM_BANKS=1
CONFIG_DEFAULT_DEVICE_TREE="bl808-d0-ox64"
CONFIG_SYS_LOAD_ADDR=0x51000000
CONFIG_TARGET_BOUFFALO_BL808=y
CONFIG_BL808_CPU_D0=y
CONFIG_ARCH_RV64I=y
CONFIG_RISCV_SMODE=y
CONFIG_DISTRO_DEFAULTS=y
# CONFIG_SYS_MALLOC_CLEAR_ON_INIT is not set
# CONFIG_BOOTSTD is not set
CONFIG_DYNAMIC_SYS_CLK_FREQ=y
CONFIG_CMD_CLK=y
CONFIG_CMD_GPIO=y
CONFIG_CMD_MMC=y
CONFIG_MMC=y
CONFIG_MMC_BROKEN_CD=y
CONFIG_MMC_SDHCI=y
CONFIG_MMC_SDHCI_BFLB=y
CONFIG_PINCTRL=y
CONFIG_PINCONF=y
# CONFIG_PINCONF_RECURSIVE is not set
CONFIG_PINCTRL_BFLB=y
CONFIG_DM_RESET=y
CONFIG_RESET_BL808=y
```

## configs/bl808_m0_defconfig
```kconfig
CONFIG_RISCV=y
CONFIG_SYS_MALLOC_LEN=0x4000
CONFIG_NR_DRAM_BANKS=1
CONFIG_DEFAULT_DEVICE_TREE="bl808-m0-ox64"
CONFIG_SYS_LOAD_ADDR=0x51000000
CONFIG_TARGET_BOUFFALO_BL808=y
CONFIG_XIP=y
# CONFIG_SYS_MALLOC_CLEAR_ON_INIT is not set
CONFIG_SYS_MONITOR_LEN=1048576
# CONFIG_BOOTSTD is not set
# CONFIG_LEGACY_IMAGE_FORMAT is not set
CONFIG_DYNAMIC_SYS_CLK_FREQ=y
# CONFIG_AUTOBOOT is not set
CONFIG_HUSH_PARSER=y
# CONFIG_CMD_BOOTD is not set
# CONFIG_CMD_BOOTM is not set
# CONFIG_CMD_BOOTI is not set
# CONFIG_CMD_ELF is not set
# CONFIG_CMD_IMI is not set
# CONFIG_CMD_XIMG is not set
CONFIG_CMD_CLK=y
CONFIG_CMD_GPIO=y
# CONFIG_CMD_LOADB is not set
# CONFIG_CMD_LOADS is not set
CONFIG_CMD_MMC=y
CONFIG_CMD_REMOTEPROC=y
CONFIG_CMD_FS_GENERIC=y
CONFIG_DOS_PARTITION=y
CONFIG_EFI_PARTITION=y
CONFIG_OF_EMBED=y
# CONFIG_NET is not set
# CONFIG_I2C is not set
# CONFIG_INPUT is not set
CONFIG_MMC=y
CONFIG_MMC_BROKEN_CD=y
# CONFIG_MMC_HW_PARTITIONING is not set
CONFIG_MMC_SDHCI=y
CONFIG_MMC_SDHCI_BFLB=y
# CONFIG_MTD is not set
CONFIG_PINCTRL=y
CONFIG_PINCONF=y
CONFIG_PINCTRL_BFLB=y
# CONFIG_POWER is not set
CONFIG_RAM=y
# CONFIG_RAM_SIFIVE is not set
CONFIG_REMOTEPROC_BFLB=y
CONFIG_DM_RESET=y
CONFIG_RESET_BL808=y
CONFIG_SYSRESET=y
CONFIG_SYSRESET_BL808=y
CONFIG_FS_EXT4=y
# CONFIG_GZIP is not set
# CONFIG_EFI_LOADER is not set
# CONFIG_LMB is not set
```

## configs/mangopi_mq_dual_defconfig
```kconfig
CONFIG_ARM=y
CONFIG_SYS_ARCH_TIMER=y
CONFIG_ARCH_SUNXI=y
CONFIG_DEFAULT_DEVICE_TREE="sun8i-t113-mangopi-mq-dual"
CONFIG_SPL_SYS_MALLOC_F_LEN=0xc000
CONFIG_MACH_SUN8I_T113=y
CONFIG_DRAM_ZQ=0
# CONFIG_HAS_ARMV7_SECURE_BASE is not set
# CONFIG_DISPLAY_CPUINFO is not set
CONFIG_SYS_SPL_MALLOC=y
CONFIG_SPL_DM=y
# CONFIG_SPL_USE_TINY_PRINTF is not set
```

## drivers/ram/bflb/Kconfig
```kconfig
config RAM_BFLB
	bool "Ram drivers support for Bouffalo Lab SoCs"
	depends on RAM && TARGET_BOUFFALO_BL808
	default y
	help
	  This enables support for RAM drivers on Bouffalo Lab SoCs.
```

## drivers/ram/sunxi/Kconfig
```kconfig
config RAM_SUNXI
	bool "Ram drivers support for sunxi SoCs"
	depends on RAM && TARGET_SUNXI
	default y
	help
	  This enables support for ram drivers of sunxi SoCs.
```
